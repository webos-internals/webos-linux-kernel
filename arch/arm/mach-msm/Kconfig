## arch/arm/mach-omap3pe/Kconfig
```kconfig
comment "OMAP Core Type"
	depends on ARCH_OMAP3

config ARCH_OMAP34XX
	bool "OMAP34xx Based System"
	depends on ARCH_OMAP3

config ARCH_OMAP3430
	bool "OMAP3430 support"
	depends on ARCH_OMAP3 && ARCH_OMAP34XX
	select ARCH_OMAP_OTG

config ARCH_OMAP3410
	bool "OMAP3410 support"
	depends on ARCH_OMAP3 && ARCH_OMAP34XX
	
comment "OMAP Board Type"
	depends on ARCH_OMAP3

config MACH_OMAP_LDP
	bool "OMAP 3 LDP board"
	depends on ARCH_OMAP3 && ARCH_OMAP34XX

config MACH_OMAP_3430SDP
	bool "OMAP 3430 SDP board"
	depends on ARCH_OMAP3 && ARCH_OMAP34XX

config MACH_OMAP3EVM
	bool "OMAP 3530 EVM board"
	depends on ARCH_OMAP3 && ARCH_OMAP34XX

config MACH_OMAP3_BEAGLE
	bool "OMAP3 BEAGLE board"
	depends on ARCH_OMAP3 && ARCH_OMAP34XX

config MACH_SIRLOIN
	bool "OMAP 3430 Sirloin board"
	depends on ARCH_OMAP3 && ARCH_OMAP34XX
	help

config FASTPATH
	bool "Critical Battery Check"
	depends on MACH_SIRLOIN && BATTERY_SIMPLE
	help
		Uses the RTC to schedule periodic fast wakeup from sleep to
		check for critical batttery levels.

config DISABLE_WFI
	bool "Disable WFI instruction in CPU idle loop (for JTAG debugging)"
	depends on MACH_FLANK || MACH_SIRLOIN
	help
	  Enabling this option will prevent the WFI instuction to be executed
	  in the CPU idle loop.

	  You need to enable this option if you want to debug the system with
	  JTAG as the WFI instruction will cause JTAG to break when executed.

config INTERCONNECT_IO_POSTING
        bool "Enable bus posting for PIO accesses"
        depends on ARCH_OMAP3
        default n
        ---help--- 
        This option sets PIO access for internal OMAP3 registers to follow the
        ARMv7 DEVICE attribute. For 3430 this will allow posted writes in the
        interconnect. Software will need to synchronize writes to ensure
        completion. When not set the attribute is Strongly Ordered which is
        non-posted on the OMAP3 interconnect.

comment "OMAP Power Management"
	depends on PM && ARCH_OMAP3

menu "Power Management Options"
	depends on PM && ARCH_OMAP3

config OMAP3_PM
	bool "Enable TI OMAP Power Management"
	depends on PM && ARCH_OMAP3
	default n

choice
	prompt "Choose Voltage Scale method"
	depends on OMAP3_PM
	default OMAP_VOLT_SR_BYPASS

config OMAP_VOLT_SR_BYPASS
	bool "Voltage Scale via Smart Reflex in bypass"
	depends on OMAP3_PM
	help
	Voltage scaling using direct register writes to OMAP3 voltage processor

config OMAP_VOLT_SR
	bool "Voltage scaling using Smart Reflex convergence"
	depends on OMAP3_PM
	help
	Voltage scaling using error feedback on OMAP3 voltage processor

config OMAP_VOLT_VSEL
	bool "Voltage scaling using VSEL writes"
	help
	Voltage scaling by OMAP2/3 I2C writes to Triton2 power chip

config OMAP_VOLT_VMODE
	bool "Voltage scaling using VMODE pins"
	help
	Voltage scaling using by OMAP2/3 VMODE pin toggling
endchoice

comment "Default VDD1 OPP Level Selection"
	depends on OMAP3_PM

choice
	prompt "VDD1 OPP"
	depends on OMAP3_PM
	default OMAP3ES2_VDD1_OPP3

config OMAP3ES2_VDD1_OPP1
	bool "MPU-125Mhz/DSP-90Mhz(OPP1)"
	depends on OMAP3_PM
	help
	  Select this option if you want to boot at OPP1.

config OMAP3ES2_VDD1_OPP2
	bool "MPU-250Mhz/DSP-180Mhz(OPP2)"
	depends on OMAP3_PM
	help
	  Select this option if you want to boot at OPP2.

config OMAP3ES2_VDD1_OPP3
	bool "MPU-500Mhz/DSP-360Mhz(OPP3)"
	depends on OMAP3_PM
	help
	  Select this option if you want to boot at OPP3.

config OMAP3ES2_VDD1_OPP4
	bool "MPU-550Mhz/DSP-396Mhz(OPP4)"
	depends on OMAP3_PM
	help
	  Select this option if you want to boot at OPP4.

config OMAP3ES2_VDD1_OPP5
	bool "MPU-625Mhz/DSP-430Mhz(OPP5)"
	depends on OMAP3_PM
	help
	  Select this option if you want to boot at OPP5.

endchoice

comment "Default VDD2 OPP Level Selection"
	depends on OMAP3_PM

choice
	prompt "VDD2 OPP"
	depends on OMAP3_PM
	default OMAP3ES2_VDD2_OPP3

config OMAP3ES2_VDD2_OPP2
	bool "L3 83Mhz(OPP2)"
	depends on OMAP3_PM
	help
	  Select this option if you want to boot at VDD2 OPP2.

config OMAP3ES2_VDD2_OPP3
	bool "L3 166Mhz(OPP3)"
	depends on OMAP3_PM
	help
	  Select this option if you want to boot at VDD2 OPP2.

endchoice

config ENABLE_VOLTSCALE_IN_SUSPEND
	bool "Enable Voltage scaling during Supend/Resume"
	depends on OMAP3_PM
	default n
	---help---
	This option is for voltage scaling during Suspend/Resume.

config RESET_IVA_IN_SUSPEND
	bool "Force IVA2 into idle during suspend"
	depends on OMAP3_PM
	default n
	---help---
	Enabling this option will RESET the IVA2 during suspend, forcing it
	into idle mode. Use this option if no other subsystem is putting the
	IVA2 into RET or OFF mode during suspend.

config MPU_OFF
	bool "Enable MPU off in suspend/resume and cpuidle"
	depends on OMAP3_PM
	default n
	---help---
	This option is for enabling MPU domain to go to OFF state in cpuidle and
	suspend/resume.	

config OMAP34XX_OFFMODE
	bool "Enable OFF Mode for 3430"
	depends on OMAP3_PM
	default n
	---help---
	This option enables all off modes frameworks and allows power domains to go to
	off with context save/restore

config CORE_OFF
	bool "Enable CORE off"
	depends on MPU_OFF && OMAP34XX_OFFMODE
	---help---
	This option is for enabling CORE domain to go to OFF state in suspend/resume

config CORE_OFF_CPUIDLE
	bool "Enable CORE off in cpuidle"
	depends on CORE_OFF
	default n
	---help---
	This option is for enabling CORE domain to go to OFF state in cpuidle

config SYSOFFMODE
	bool "Enable sysoff mode and VDD1/2 scaling to 0V"
	depends on CORE_OFF
	default n
	---help---
	This option is for enabling sysoffmode when chip off happens.

config HW_SUP_TRANS
	bool "OMAP3430 enable H/W supervised transition for clock domains"
	depends on OMAP3_PM
	default n

config TRACK_RESOURCES 
	bool "Enable resource tracking"
	depends on OMAP3_PM
	default n
	---help---
	This option enables tracking of resources such as clock and voltage sources. 

config	AUTO_POWER_DOMAIN_CTRL 
	bool "Enable automatic power domain control"
	depends on OMAP3_PM
	default y
	---help---
	This option enables automatic control of power domains through the clock
	framework. 

config PREVENT_MPU_RET
	bool "Prevent Mpu retention"
	depends on OMAP3_PM
	default n
	---help---
	This option is for disabling mpu retention through osidle during bootup. It can
	be changed later using sysfs interface.

config PREVENT_CORE_RET
	bool "Prevent Core retention"
	depends on OMAP3_PM
	default n
	---help---
	This option is for disabling core retention through osidle during bootup. It
	can be changed later using sysfs interface.

config DISABLE_EMUDOMAIN_CONTROL
	bool "Disable h/w supervised control of EMU clock domain"
	depends on OMAP3_PM
	default y
	---help---
	This option is for disabling h/w supervised control of EMU clock domain.
	Required for debugging using JTAG.

endmenu
```

## drivers/cpuidle/Kconfig
```kconfig
config CPU_IDLE
	bool "CPU idle PM support"
	default	y
	help
	  CPU idle is a generic framework for supporting software-controlled
	  idle processor power management.  It includes modular cross-platform
	  governors that can be swapped during runtime.

	  If you're using a mobile platform that supports CPU idle PM (e.g.
	  an ACPI-capable notebook), you should say Y here.

if CPU_IDLE

comment "Governors"

config CPU_IDLE_GOV_LADDER
	bool "Ladder"
	depends on CPU_IDLE
	default n

config CPU_IDLE_GOV_MENU
	bool "Menu"
	depends on CPU_IDLE && NO_HZ
	default y
endif #CPU_IDLE
```

## drivers/input/accelerometer/Kconfig
```kconfig
#
# Input accelerometers configuration
#
menuconfig INPUT_ACCELEROMETER
	bool "Accelerometers" if EMBEDDED
	default n
	help
	  Say Y here, and a list of supported accelerometers will be displayed.
	  This option doesn't affect the kernel.

	  If unsure, say N.

if INPUT_ACCELEROMETER

config ACCELEROMETER_KXSD9
        tristate "KXSD9 based accelerometer"
        depends on INPUT_ACCELEROMETER && I2C
	default n
        help
          Say Y here if you want to use the KXSD9 based accelerometer.
		  
config ACCELEROMETER_TEST_DEBUG_KXSD9
        tristate "KXSD9 based accelerometer test debug Mode"
        depends on INPUT_ACCELEROMETER && I2C && ACCELEROMETER_KXSD9
	default n
        help
          Say Y here if you want to debug and test the KXSD9 based accelerometer.

config ACCELEROMETER_KXTE9
        tristate "KXTE9 based accelerometer"
        depends on I2C
	default n
        help
          Say Y here if you want to use the KXTE9 based accelerometer.

config ACCELEROMETER_TEST_DEBUG_KXTE9
        tristate "KXTE9 based accelerometer test debug Mode"
        depends on I2C && ACCELEROMETER_KXTE9
	default n
        help
          Say Y here if you want to debug and test the KXTE9 based accelerometer.      
endif
```

## drivers/media/video/msm/Kconfig
```kconfig
if ARCH_MSM

comment "Camera Sensor Selection"
config MT9T013
	bool "Sensor mt9t013 (BAYER 3M)"
	---help---
	  MICRON 3M Bayer Sensor with AutoFocus

config MT9D112
	bool "Sensor mt9d112 (YUV   2M)"
	---help---
	  MICRON 2M YUV Sensor

config VIDEO_MSM
	tristate "MSM Video Overlay Support"
	select VIDEOBUF_GEN
	select VIDEOBUF_DMA_SG
	help
	  This options enables support for msm video overlay

endif # ARCH_MSM
```

## drivers/media/video/omap/Kconfig
```kconfig
menu "OMAP16xx V4L2 drivers"
	depends on VIDEO_DEV && ARCH_OMAP16XX
config VIDEO_OMAP_CAMERA
	tristate "OMAP Camera support (EXPERIMENTAL)"
	depends on VIDEO_DEV && (ARCH_OMAP16XX || ARCH_OMAP24XX)
	help
	  V4L2 camera driver support for OMAP1/2 based boards.
	
config VIDEO_CAMERA_SENSOR_OV9640
	tristate "OV9640 sensor support"
	depends on VIDEO_OMAP_CAMERA
	help
	  OmniVision 9640 camera sensor support
endmenu

menu "OMAP2/OMAP3 V4L2 drivers"
	depends on VIDEO_DEV && (ARCH_OMAP24XX || ARCH_OMAP34XX)

config VIDEO_OMAP24XX_VIDEOLIB
	tristate "Video out library"

config VIDEO_OMAP24XX_VIDEOOUT
	tristate "Video out driver"
	depends on VIDEO_OMAP24XX_VIDEOLIB

config VIDEO_OMAP24XX_TVOUT
	bool "TV out support"

config VIDEO_OMAP24XX_CAMERA
	tristate "Camera driver"
	depends on VIDEO_OMAP24XX_VIDEOLIB && ARCH_OMAP24XX 

config VIDEO_OMAP34XX_CAMERA
	tristate "Camera driver"
	depends on VIDEO_OMAP24XX_VIDEOLIB && ARCH_OMAP34XX 

config VIDEO_OMAP_SENSOR_MT9D111
	tristate "Micron mt9d111 (EX3691) ISP sensor driver"
	depends on ARCH_OMAP2430 || ARCH_OMAP34XX  

config VIDEO_OMAP_SENSOR_MT9D112
	tristate "Micron MT9D112 ISP sensor driver (2MP)"
	depends on ARCH_OMAP2430

config VIDEO_OMAP_SENSOR_MT9P012
	tristate "Micron mt9p012 raw sensor driver (5MP)"
	depends on ARCH_OMAP34XX
	default y

config VIDEO_OMAP_AF_D88
	tristate "Auto Focus driver coil D88"
	depends on ARCH_OMAP34XX && VIDEO_OMAP_SENSOR_MT9P012
	default y
	
config VIDEO_OMAP_SENSOR_OV3640
	tristate "OV3640 sensor support (3MP)"
	depends on ARCH_OMAP34XX && !VIDEO_OMAP_SENSOR_MT9P012

source "drivers/media/video/omap/isp/Kconfig"
source "drivers/media/video/omap/gci/Kconfig"
endmenu
```

## drivers/media/video/omap/gci/Kconfig
```kconfig
menu "OMAP3 GCI Camera driver"
	depends on VIDEO_DEV && (ARCH_OMAP24XX || ARCH_OMAP34XX)

config VIDEO_OMAP_GCI_CAMERA
	tristate "GCI Camera Driver"
	depends on VIDEO_OMAP24XX_VIDEOLIB && ARCH_OMAP34XX 

endmenu
```

## drivers/media/video/omap/isp/Kconfig
```kconfig
config VIDEO_OMAP34XX_ISP
	tristate "omap isp driver"
	depends on ARCH_OMAP34XX 

config VIDEO_OMAP34XX_ISP_PREVIEWER
	tristate "omap isp previewer"
	depends on VIDEO_OMAP34XX_ISP && !ARCH_OMAP3410

config VIDEO_OMAP34XX_ISP_RESIZER
	tristate "omap isp resizer"
	depends on VIDEO_OMAP34XX_ISP && !ARCH_OMAP3410
```

## drivers/media/video/omappe/Kconfig
```kconfig
config VIDEO_OMAPPE
	bool

menu "OMAP V4L2 drivers (Palm edition)"
	depends on VIDEO_DEV && (ARCH_OMAP24XX || ARCH_OMAP34XX)

config VIDEO_OMAP24XX_VIDEOLIB
	tristate "Video out library"
	select VIDEO_OMAPPE

config VIDEO_OMAP24XX_VIDEOOUT
	tristate "Video out driver"
	depends on VIDEO_OMAP24XX_VIDEOLIB
	select VIDEOBUF_GEN
	select VIDEOBUF_DMA_SG

config VIDEO_OMAP24XX_TVOUT
	bool "TV out support"
	select VIDEO_OMAPPE

config VIDEO_OMAP24XX_CAMERA
	tristate "Camera driver"
	depends on VIDEO_OMAP24XX_VIDEOLIB && ARCH_OMAP24XX
	select VIDEOBUF_GEN
	select VIDEOBUF_DMA_SG

config VIDEO_OMAP_SENSOR_MT9D112
	tristate "Micron MT9D112 ISP sensor driver (2MP)"
	depends on ARCH_OMAP2430
	select VIDEO_OMAPPE

config VIDEO_OMAP34XX_VIDEOBUF
	tristate
	select VIDEOBUF_GEN

config VIDEO_OMAP34XX_V4L2
	bool
	select VIDEO_OMAPPE
	select VIDEO_OMAP34XX_VIDEOBUF

config VIDEO_OMAP34XX_ISP
	tristate "ISP driver"
	depends on ARCH_OMAP34XX
	select VIDEO_OMAP34XX_V4L2

config VIDEO_OMAP34XX_ISP_IDIOSYNCRATIC
	bool "Mimic reference driver idiosyncracies"
	depends on VIDEO_OMAP34XX_ISP

config VIDEO_OMAP34XX_ISP_PREVIEW_RED_PHASE
	bool "Force first preview input pixel to be red"
	depends on VIDEO_OMAP34XX_ISP_IDIOSYNCRATIC

config VIDEO_OMAP34XX_ISP_DBG
	bool "Debugging support"
	depends on VIDEO_OMAP34XX_ISP

comment "ISP interfaces"

config VIDEO_OMAP34XX_ISP_SMIA10
	tristate "SMIA 1.0"
	depends on VIDEO_OMAP34XX_ISP

comment "ISP video devices"

config VIDEO_OMAP34XX_ISP_VIDEO
	tristate "Video capture"
	depends on VIDEO_OMAP34XX_ISP

config FORCE_MAX_ZONEORDER
	int "Maximum memory zone order"
	depends on VIDEO_OMAP34XX_ISP_VIDEO

config VIDEO_OMAP34XX_ISP_STATS
	tristate "Stats capture"
	depends on VIDEO_OMAP34XX_ISP

endmenu
```
