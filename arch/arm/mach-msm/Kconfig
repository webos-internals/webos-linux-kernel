## drivers/mmc/host/Kconfig
```kconfig
#
# MMC/SD host controller drivers
#

comment "MMC/SD Host Controller Drivers"

config MMC_ARMMMCI
	tristate "ARM AMBA Multimedia Card Interface support"
	depends on ARM_AMBA
	help
	  This selects the ARM(R) AMBA(R) PrimeCell Multimedia Card
	  Interface (PL180 and PL181) support.  If you have an ARM(R)
	  platform with a Multimedia Card slot, say Y or M here.

	  If unsure, say N.

config MMC_PXA
	tristate "Intel PXA25x/26x/27x Multimedia Card Interface support"
	depends on ARCH_PXA
	help
	  This selects the Intel(R) PXA(R) Multimedia card Interface.
	  If you have a PXA(R) platform with a Multimedia Card slot,
	  say Y or M here.

	  If unsure, say N.

config MMC_SDHCI
	tristate "Secure Digital Host Controller Interface support  (EXPERIMENTAL)"
	depends on PCI && EXPERIMENTAL
	help
	  This select the generic Secure Digital Host Controller Interface.
	  It is used by manufacturers such as Texas Instruments(R), Ricoh(R)
	  and Toshiba(R). Most controllers found in laptops are of this type.
	  If you have a controller with this interface, say Y or M here.

	  If unsure, say N.

config MMC_RICOH_MMC
	tristate "Ricoh MMC Controller Disabler  (EXPERIMENTAL)"
	depends on PCI && EXPERIMENTAL && MMC_SDHCI
	help
	  This selects the disabler for the Ricoh MMC Controller. This
	  proprietary controller is unnecessary because the SDHCI driver
	  supports MMC cards on the SD controller, but if it is not
	  disabled, it will steal the MMC cards away - rendering them
	  useless. It is safe to select this driver even if you don't
	  have a Ricoh based card reader.


	  To compile this driver as a module, choose M here:
	  the module will be called ricoh_mmc.

	  If unsure, say Y.

config MMC_OMAP
	tristate "TI OMAP Multimedia Card Interface support"
	depends on (ARCH_OMAP1 || ARCH_OMAP2420) && MMC
	select TPS65010 if MACH_OMAP_H2
	help
	  This selects the TI OMAP Multimedia card Interface.
	  If you have an OMAP board with a Multimedia Card slot,
	  say Y or M here.

	  If unsure, say N.

choice
    prompt "TI OMAP24XX/34XX Multimedia Card Interface support"
	depends on MMC && ( ARCH_OMAP24XX || ARCH_OMAP34XX )

config MMC_DRV_PE
	bool "Palm edition"
	help
	  This selects Palm edition of OMAP Multimedia card Interface driver.

config MMC_DRV_TE
	bool "TI edition"
	help
	  This selects the TI edition of OMAP Multimedia card Interface driver.
endchoice

config MMC_HSMMC_PE
	tristate "TI OMAP24XX/34XX driver (Palm edition)"
	depends on MMC && MMC_DRV_PE
	default n
	select OMAP2430_MMC1 if ARCH_OMAP2430
	select OMAP2430_MMC2 if ARCH_OMAP2430
	select OMAP3430_MMC1 if ARCH_OMAP3430
	select OMAP3430_MMC2 if ARCH_OMAP3430
	help
	  This selects the TI OMAP24XX/34XX Multimedia card Interface.
	  If you have an OMAP board with a Multimedia Card slot,
	  say Y or M here.

	  If unsure, say N.

config OMAP_SDIO_PE
	boolean "OMAP SDIO Support (Palm edition)"
	depends on MMC_HSMMC_PE 
	default y
	help
	  This selects SDIO support for OMAP24XX/34XX Multimedia Card Interface (Palm edition).
	  If unsure, say N.

config MMC_OMAP2430
	tristate "TI OMAP2430  Multimedia Card Interface support"
	depends on ARCH_OMAP2430 && MMC && MMC_DRV_TE
	default y if MMC
	help
	  This selects the TI OMAP2430 Multimedia card Interface.
	  If you have an OMAP board with a Multimedia Card slot,
	  say Y or M here.

	  If unsure, say N.

config OMAP2430_MMC1
	boolean "TI OMAP2430 MMC1 Support "
	depends on MMC_OMAP2430
	default y if MMC_OMAP2430
	help
	  This selects the TI OMAP2430 MMC1 controller support.
	  If you have an OMAP board with a Multimedia Card slot,
	  say Y or M here.

config OMAP2430_MMC2
	boolean "TI OMAP2430 MMC2 Support "
	depends on MMC_OMAP2430
	default y if MMC_OMAP2430
	help
	  This selects the TI OMAP2430 MMC2 controller support.
	  If you have an OMAP board with a Multimedia Card slot,
	  say Y or M here.

config MMC_OMAP3430
	tristate "TI OMAP3430  Multimedia Card Interface support"
	depends on ARCH_OMAP3 && MMC && MMC_DRV_TE
	default y if MMC
	help
	  This selects the TI OMAP3430 Multimedia card Interface.
	  If you have an OMAP board with a Multimedia Card slot,
	  say Y or M here.
	  If unsure, say N.

config OMAP3430_MMC1
	boolean "TI OMAP3430 MMC1 Support "
	depends on MMC_OMAP3430
	default y if MMC_OMAP3430
	help
	  This selects the TI OMAP3430 MMC1 controller support.
	  If you have an OMAP board with a Multimedia Card slot,
	  say Y or M here.

config OMAP3430_MMC2
	boolean "TI OMAP3430 MMC2 Support "
	depends on MMC_OMAP3430
	default y if MMC_OMAP3430
	help
	  This selects the TI OMAP3430 MMC2 controller support.
	  If you have an OMAP board with a Multimedia Card slot,
	  say Y or M here.

config OMAP_SDIO
	boolean "OMAP SDIO Support"
	depends on (MMC_OMAP2430 || MMC_OMAP3430)
	default y
	help
	  This selects the OMAP SDIO driver support.
	  If unsure, say N.

config OMAP_SDIO_NON_DMA_MODE
	boolean "Use the SDIO card in non dma mode"
	depends on OMAP_SDIO
	default n
	help
	  This selects the MMC driver to run in non-dma mode.
	  If unsure, say N.

config MMC_WBSD
	tristate "Winbond W83L51xD SD/MMC Card Interface support"
	depends on ISA_DMA_API
	help
	  This selects the Winbond(R) W83L51xD Secure digital and
          Multimedia card Interface.
	  If you have a machine with a integrated W83L518D or W83L519D
	  SD/MMC card reader, say Y or M here.

	  If unsure, say N.

config MMC_AU1X
	tristate "Alchemy AU1XX0 MMC Card Interface support"
	depends on SOC_AU1200
	help
	  This selects the AMD Alchemy(R) Multimedia card interface.
	  If you have a Alchemy platform with a MMC slot, say Y or M here.

	  If unsure, say N.

config MMC_AT91
	tristate "AT91 SD/MMC Card Interface support"
	depends on ARCH_AT91
	help
	  This selects the AT91 MCI controller.

	  If unsure, say N.

config MMC_IMX
	tristate "Motorola i.MX Multimedia Card Interface support"
	depends on ARCH_IMX
	help
	  This selects the Motorola i.MX Multimedia card Interface.
	  If you have a i.MX platform with a Multimedia Card slot,
	  say Y or M here.

	  If unsure, say N.

config MMC_TIFM_SD
	tristate "TI Flash Media MMC/SD Interface support  (EXPERIMENTAL)"
	depends on EXPERIMENTAL && PCI
	select TIFM_CORE
	help
	  Say Y here if you want to be able to access MMC/SD cards with
	  the Texas Instruments(R) Flash Media card reader, found in many
	  laptops.
	  This option 'selects' (turns on, enables) 'TIFM_CORE', but you
	  probably also need appropriate card reader host adapter, such as
	  'Misc devices: TI Flash Media PCI74xx/PCI76xx host adapter support
	  (TIFM_7XX1)'.

          To compile this driver as a module, choose M here: the
	  module will be called tifm_sd.

config MMC_SPI
	tristate "MMC/SD over SPI (EXPERIMENTAL)"
	depends on MMC && SPI_MASTER && !HIGHMEM && EXPERIMENTAL
	select CRC7
	select CRC_ITU_T
	help
	  Some systems accss MMC/SD cards using a SPI controller instead of
	  using a "native" MMC/SD controller.  This has a disadvantage of
	  being relatively high overhead, but a compensating advantage of
	  working on many systems without dedicated MMC/SD controllers.

	  If unsure, or if your system has no SPI master driver, say N.
```

## drivers/ssi/Kconfig
```kconfig
menu "Synchronous Serial Interfaces (SSI)"

config OMAP_MCBSP
        depends on ARCH_OMAP2 || ARCH_OMAP3
        bool "McBSP Support on OMAP"
	default y
        ---help---
          Say Y here if you want support for the Muilti Channeled Buffered Serial Port interface
          on an OMAP processor.
          Automatically selected if SOUND_OMAP_TSC2101 is selected

menu "McBSP fifo support"
        depends on ARCH_OMAP3

config USE_MCBSP_FIFO
        depends on ARCH_OMAP34XX
        bool "Enable McBSP fifo "
        default n
        ---help---
        Enables the fifo usage for 34xx platform
endmenu
config OMAP_HDQ
	depends on ARCH_OMAP24XX || ARCH_OMAP34XX
	tristate "HDQ support on OMAP"
	---help---
	  Say Y here if you want support for the HDQ Interface
	  on an OMAP processor.

config OMAP_HDQ_SYSFS
	depends on OMAP_HDQ
	bool "HDQ driver sysfs support"
	default y
	---help---
	  Say Y here if HDQ driver sysfs support is needed.
endmenu
```

## drivers/video/omap/Kconfig
```kconfig
config FB_OMAP
	tristate "OMAP frame buffer support (EXPERIMENTAL)"
	depends on FB && ARCH_OMAP
	select FB_CFB_FILLRECT
	select FB_CFB_COPYAREA
	select FB_CFB_IMAGEBLIT
	help
          Frame buffer driver for OMAP based boards.

config FB_OMAP_LCDC_EXTERNAL
	bool "External LCD controller support"
	depends on FB_OMAP
	help
	  Say Y here, if you want to have support for boards with an
	  external LCD controller connected to the SoSSI/RFBI interface.

config FB_OMAP_LCDC_HWA742
	bool "Epson HWA742 LCD controller support"
	depends on FB_OMAP && FB_OMAP_LCDC_EXTERNAL
	help
	  Say Y here if you want to have support for the external
	  Epson HWA742 LCD controller.

config FB_OMAP_LCDC_BLIZZARD
	bool "Epson Blizzard LCD controller support"
	depends on FB_OMAP && FB_OMAP_LCDC_EXTERNAL
	help
	  Say Y here if you want to have support for the external
	  Epson Blizzard LCD controller.

config FB_OMAP_MANUAL_UPDATE
	bool "Default to manual update mode"
	depends on FB_OMAP && FB_OMAP_LCDC_EXTERNAL
	help
	  Say Y here, if your user-space applications are capable of
	  notifying the frame buffer driver when a change has occured in
          the frame buffer content and thus a reload of the image data to
	  the external frame buffer is required. If unsure, say N.

config FB_OMAP_LCD_MIPID
	bool "MIPI DBI-C/DCS compatible LCD support"
	depends on FB_OMAP && SPI_MASTER && CBUS_TAHVO
	help
	  Say Y here if you want to have support for LCDs compatible with
	  the Mobile Industry Processor Interface DBI-C/DCS
	  specification. (Supported LCDs: Philips LPH8923, Sharp LS041Y3)

config FB_OMAP_BOOTLOADER_INIT
	bool "Check bootloader initialization"
	depends on FB_OMAP
	help
	  Say Y here if you want to enable checking if the bootloader has
	  already initialized the display controller. In this case the
	  driver will skip the initialization.

config FB_OMAP_CONSISTENT_DMA_SIZE
	int "Consistent DMA memory size (MB)"
	depends on FB_OMAP
	range 1 14
	default 2
	help
	  Increase the DMA consistent memory size according to your video
	  memory needs, for example if you want to use multiple planes.
	  The size must be 2MB aligned.
	  If unsure say 1.

config FB_OMAP_DMA_TUNE
        bool "Set DMA SDRAM access priority high"
        depends on FB_OMAP && ARCH_OMAP1
        help
          On systems in which video memory is in system memory
          (SDRAM) this will speed up graphics DMA operations.
          If you have such a system and want to use rotation
          answer yes. Answer no if you have a dedicated video
          memory, or don't use any of the accelerated features.

config FB_OMAP_LCDC_EXTERNAL
	bool "External LCD controller support"
	depends on FB_OMAP
	help
	  Say Y here, if you want to have support for boards with an
	  external LCD controller connected to the SoSSI/RFBI interface.

config FB_OMAP_LCDC_HWA742
	bool "Epson HWA742 LCD controller support"
	depends on FB_OMAP && FB_OMAP_LCDC_EXTERNAL
	help
	  Say Y here if you want to have support for the external
	  Epson HWA742 LCD controller.

config FB_OMAP_LCDC_BLIZZARD
	bool "Epson Blizzard LCD controller support"
	depends on FB_OMAP && FB_OMAP_LCDC_EXTERNAL
	help
	  Say Y here if you want to have support for the external
	  Epson Blizzard LCD controller.

config FB_OMAP_LCD_VGA
	tristate "OMAP 3430 SDP VGA Display"
	depends on ARCH_OMAP34XX

config FB_OMAP_DISPLAY_CLASS
	tristate "OMAP display class support (EXPERIMENTAL)"
	depends on FB_OMAP && (ARCH_OMAP34XX || ARCH_OMAP24XX)
	help
	  Say Y here if you wan tto use the generic linux display controller
	  interface with the omap processor

config FB_OMAP_CONTROLLER
	tristate "Support for OMAP display controllers"
	depends on FB_OMAP_DISPLAY_CLASS && (ARCH_OMAP34XX)
	help
	  Say Y here if you want to use OMAP LCD display controller

config OMAP_DISPLAY_ENABLE_AUTO_LPR_AT_BOOT
	bool "Enable AUTO LPR mode for OMAP LCD controller at boot time"
	depends on FB_OMAP_CONTROLLER
	help
	  Say Y here if you want to enable automatic handling of the OMAP LCD
	  controller LPR (Low Power Refresh) mode at boot time.

	  You can choose N here and enable automatic LPR mode handling at
	  run-time using the lpr_mode sysfs entry.

config FB_OMAP_BACKLIGHT_TPS61060
	tristate "Support for LCD backlight control using TPS61060 LED driver"
	depends on FB_OMAP_DISPLAY_CLASS
	help
	  Say Y here if you want to control the LCD backlight using the TI TPS61060
	  chip

config FB_OMAP_BACKLIGHT_MAXIM8831
	tristate "Support for LCD backlight control using MAXIM8831 chip"
	depends on FB_OMAP_DISPLAY_CLASS && I2C && LEDS_MAXIM8831
	help
	  Say Y here if you want to use the Maxim 8831 chip to control the LCD backlight

config FB_OMAP_BACKLIGHT_EVT
	tristate "Support for LCD backlight control on Castle board"
	depends on FB_OMAP_DISPLAY_CLASS && I2C && LEDS_MAXIM8831
	help
	  Say Y here if you want to use the LCD backlight Castle board

config FB_OMAP_PANEL_ACX567AKM
	tristate "Support for Sony's ACX567AKM series displays"
	depends on FB_OMAP_DISPLAY_CLASS && SPI && ARCH_OMAP3430
	help
	  Say Y here if you want to use Sony's acx567akm series LCD panels

config SPI_ACX567AKM_BACKLIGHT
	bool "Built-in backlight control"
	depends on FB_OMAP_PANEL_ACX567AKM

config OMAP_DISPLAY_ALREADY_ON_AT_BOOT
       bool "Display is already on and configured during boot"
       depends on FB_OMAP_PANEL_ACX567AKM
       help
         Say Y here if display is already on and configured before init runs.  
         Note, the display is must be configured for the same values that 
         the drivers are configured for.

config SPI_ACX567AKM_DBG
	bool "Debugging support"
	depends on FB_OMAP_PANEL_ACX567AKM

config FB_OMAP_PANEL_FPD95220
	tristate "Support for National Semi's FPD95220 series display controllers"
	depends on FB_OMAP_DISPLAY_CLASS && SPI
	help
	  Say Y here if you want to use LCD panels with National Semi's FPD95220
	  series display controllers

config FB_OMAP_ON_VIDEO_LAYER
	tristate "Omap frame buffer on video layer"
	depends on FB_OMAP_DISPLAY_CLASS && ARCH_OMAP3430 && FB_OMAP_CONTROLLER
	help
	  Say Y here if you want to use an Omap Video layer as a frame buffer
```
