## drivers/misc/Kconfig
```kconfig
#
# Misc strange devices
#

menuconfig MISC_DEVICES
	bool "Misc devices"
	default y
	---help---
	  Say Y here to get to see options for device drivers from various
	  different categories. This option alone does not add any kernel code.

	  If you say N, all options in this submenu will be skipped and disabled.

if MISC_DEVICES

config IBM_ASM
	tristate "Device driver for IBM RSA service processor"
	depends on X86 && PCI && INPUT && EXPERIMENTAL
	---help---
	  This option enables device driver support for in-band access to the
	  IBM RSA (Condor) service processor in eServer xSeries systems.
	  The ibmasm device driver allows user space application to access
	  ASM (Advanced Systems Management) functions on the service
	  processor. The driver is meant to be used in conjunction with
	  a user space API.
	  The ibmasm driver also enables the OS to use the UART on the
	  service processor board as a regular serial port. To make use of
	  this feature serial driver support (CONFIG_SERIAL_8250) must be
	  enabled.

	  WARNING: This software may not be supported or function
	  correctly on your IBM server. Please consult the IBM ServerProven
	  website <http://www.pc.ibm.com/ww/eserver/xseries/serverproven> for
	  information on the specific driver level and support statement
	  for your IBM server.

config PHANTOM
	tristate "Sensable PHANToM"
	depends on PCI
	help
	  Say Y here if you want to build a driver for Sensable PHANToM device.

	  If you choose to build module, its name will be phantom. If unsure,
	  say N here.

config EEPROM_93CX6
	tristate "EEPROM 93CX6 support"
	---help---
	  This is a driver for the EEPROM chipsets 93c46 and 93c66.
	  The driver supports both read as well as write commands.

	  If unsure, say N.

config SGI_IOC4
	tristate "SGI IOC4 Base IO support"
	depends on PCI
	---help---
	  This option enables basic support for the IOC4 chip on certain
	  SGI IO controller cards (IO9, IO10, and PCI-RT).  This option
	  does not enable any specific functions on such a card, but provides
	  necessary infrastructure for other drivers to utilize.

	  If you have an SGI Altix with an IOC4-based card say Y.
	  Otherwise say N.

config TIFM_CORE
	tristate "TI Flash Media interface support (EXPERIMENTAL)"
	depends on EXPERIMENTAL && PCI
	help
	  If you want support for Texas Instruments(R) Flash Media adapters
	  you should select this option and then also choose an appropriate
	  host adapter, such as 'TI Flash Media PCI74xx/PCI76xx host adapter
	  support', if you have a TI PCI74xx compatible card reader, for
	  example.
	  You will also have to select some flash card format drivers. MMC/SD
	  cards are supported via 'MMC/SD Card support: TI Flash Media MMC/SD
	  Interface support (MMC_TIFM_SD)'.

          To compile this driver as a module, choose M here: the module will
	  be called tifm_core.

config TIFM_7XX1
	tristate "TI Flash Media PCI74xx/PCI76xx host adapter support (EXPERIMENTAL)"
	depends on PCI && TIFM_CORE && EXPERIMENTAL
	default TIFM_CORE
	help
	  This option enables support for Texas Instruments(R) PCI74xx and
	  PCI76xx families of Flash Media adapters, found in many laptops.
	  To make actual use of the device, you will have to select some
	  flash card format drivers, as outlined in the TIFM_CORE Help.

          To compile this driver as a module, choose M here: the module will
	  be called tifm_7xx1.

config ASUS_LAPTOP
        tristate "Asus Laptop Extras (EXPERIMENTAL)"
        depends on X86
        depends on ACPI
	depends on EXPERIMENTAL && !ACPI_ASUS
	depends on LEDS_CLASS
	depends on BACKLIGHT_CLASS_DEVICE
        ---help---
	  This is the new Linux driver for Asus laptops. It may also support some
	  MEDION, JVC or VICTOR laptops. It makes all the extra buttons generate
	  standard ACPI events that go through /proc/acpi/events. It also adds
	  support for video output switching, LCD backlight control, Bluetooth and
	  Wlan control, and most importantly, allows you to blink those fancy LEDs.

	  For more information and a userspace daemon for handling the extra
	  buttons see <http://acpi4asus.sf.net/>.

	  If you have an ACPI-compatible ASUS laptop, say Y or M here.

config FUJITSU_LAPTOP
        tristate "Fujitsu Laptop Extras"
        depends on X86
        depends on ACPI
        depends on BACKLIGHT_CLASS_DEVICE
        ---help---
	  This is a driver for laptops built by Fujitsu:

	    * P2xxx/P5xxx/S6xxx/S7xxx series Lifebooks
	    * Possibly other Fujitsu laptop models

	  It adds support for LCD brightness control.

	  If you have a Fujitsu laptop, say Y or M here.

config MSI_LAPTOP
        tristate "MSI Laptop Extras"
        depends on X86
        depends on ACPI_EC
        depends on BACKLIGHT_CLASS_DEVICE
        ---help---
	  This is a driver for laptops built by MSI (MICRO-STAR
	  INTERNATIONAL):

	  MSI MegaBook S270 (MS-1013)
	  Cytron/TCM/Medion/Tchibo MD96100/SAM2000

	  It adds support for Bluetooth, WLAN and LCD brightness control.

	  More information about this driver is available at
	  <http://0pointer.de/lennart/tchibo.html>.

	  If you have an MSI S270 laptop, say Y or M here.

config SONY_LAPTOP
	tristate "Sony Laptop Extras"
	depends on X86 && ACPI
	select BACKLIGHT_CLASS_DEVICE
	depends on INPUT
	  ---help---
	  This mini-driver drives the SNC and SPIC devices present in the ACPI
	  BIOS of the Sony Vaio laptops.

	  It gives access to some extra laptop functionalities like Bluetooth,
	  screen brightness control, Fn keys and allows powering on/off some
	  devices.

	  Read <file:Documentation/sony-laptop.txt> for more information.

config SONYPI_COMPAT
	bool "Sonypi compatibility"
	depends on SONY_LAPTOP
	  ---help---
	  Build the sonypi driver compatibility code into the sony-laptop driver.

config THINKPAD_ACPI
	tristate "ThinkPad ACPI Laptop Extras"
	depends on X86 && ACPI
	select BACKLIGHT_CLASS_DEVICE
	select HWMON
	select NVRAM
	depends on INPUT
	---help---
	  This is a driver for the IBM and Lenovo ThinkPad laptops. It adds
	  support for Fn-Fx key combinations, Bluetooth control, video
	  output switching, ThinkLight control, UltraBay eject and more.
	  For more information about this driver see 
	  <file:Documentation/thinkpad-acpi.txt> and <http://ibm-acpi.sf.net/> .

	  This driver was formerly known as ibm-acpi.

	  If you have an IBM or Lenovo ThinkPad laptop, say Y or M here.

config THINKPAD_ACPI_DEBUG
	bool "Verbose debug mode"
	depends on THINKPAD_ACPI
	default n
	---help---
	  Enables extra debugging information, at the expense of a slightly
	  increase in driver size.

	  If you are not sure, say N here.

config THINKPAD_ACPI_DOCK
	bool "Legacy Docking Station Support"
	depends on THINKPAD_ACPI
	depends on ACPI_DOCK=n
	default n
	---help---
	  Allows the thinkpad_acpi driver to handle docking station events.
	  This support was made obsolete by the generic ACPI docking station
	  support (CONFIG_ACPI_DOCK).  It will allow locking and removing the
	  laptop from the docking station, but will not properly connect PCI
	  devices.

	  If you are not sure, say N here.

config THINKPAD_ACPI_BAY
	bool "Legacy Removable Bay Support"
	depends on THINKPAD_ACPI
	default y
	---help---
	  Allows the thinkpad_acpi driver to handle removable bays.  It will
	  electrically disable the device in the bay, and also generate
	  notifications when the bay lever is ejected or inserted.

	  If you are not sure, say Y here.

config LOW_MEMORY_KILLER
    tristate "Low Memory Killer"
	depends on LOW_MEMORY_NOTIFY
	  ---help---
	  Register processes to be killed when memory is low.

config LOW_MEMORY_NOTIFY
    bool "Low Memory Notify"
	  ---help---
	  Provide interface to register for low memory notifications.

config ATMEL_SSC
	tristate "Device driver for Atmel SSC peripheral"
	depends on AVR32 || ARCH_AT91
	---help---
	  This option enables device driver support for Atmel Syncronized
	  Serial Communication peripheral (SSC).

	  The SSC peripheral supports a wide variety of serial frame based
	  communications, i.e. I2S, SPI, etc.

	  If unsure, say N.

config TWL4030_RTC
	bool "TWL4030 RTC Driver"
	depends on TWL4030_CORE

config OMAP_BCI_BATTERY
	bool "OMAP243x/34xx Battery driver"
	depends on (MACH_OMAP_2430SDP || MACH_OMAP_3430SDP) && TWL4030_CORE
	default y
	---help---
	  Support for OMAP243x/34xx Battery driver. This driver can give support for TWL4030 Battery Charge Interface.

config OMAP_TWL4030_BATTERY_EVENTS
	bool "TWL4030 Battery monitoring and event notification"
	depends on OMAP_BCI_BATTERY
	default y
	---help---
	  Support for Battery driver's TWL4030 event handler registration and notification capabilities

config OMAP_BQ27000_BATTERY
	bool "BQ Battery monitoring and charge support"
	depends on OMAP_HDQ
	default y
	---help---
	  Support for battery driver's BQ27000 fuel gauge chip, battery monitoring capabilities.

config OMAP_BQ27000_BATTERY_EVENTS
	bool "BQ Battery monitoring and event notification"
	depends on OMAP_BQ27000_BATTERY
	default y
	---help---
	  Support for Battery driver's event handler registration and notification capabilities

config OMAP_BATTERY_SYSFS
	bool "OMAP243x/343x  Battery driver Sysfs"
	depends on OMAP_BCI_BATTERY || OMAP_BQ27000_BATTERY
	default y
	---help---
	  OMAP243x/34xx Battery driver sysfs entries.

config OMAP_VIBRATOR
	tristate "OMAP34xx Vibrator driver."
	depends on ARCH_OMAP3430
	default y
	---help---
	  Say Y here if you want to use the Vibrator driver on the OMAP34xx-based reference platform.

config PALM_QC_MODEM_HANDSHAKING_SUPPORT
	bool "Qualcomm Modem Handshaking support on Palm devices"
	default y
	help
	  Enable this option if you want support for Qualcomm Modem Handshaking on Palm
	  devices.

config OMAP_MISC_HSUART
	tristate "OMAP High speed UART device driver"
	depends on ARCH_OMAP2 || ARCH_OMAP3
	depends on HS_SERIAL_SUPPORT
	---help---
	  Select Y if you want to expose High speed UART as a non-tty (misc) device

config HSUART_LOG_EVENTS
	bool "Enable event logging (debug) for High speed UART device driver"
	depends on OMAP_MISC_HSUART
	default n
	---help---
	  Select Y if you want to enable events logging (debug) for High speed UART driver

config USER_PINS
	tristate "Sysfs GPIO pins control"
	depends on ARCH_OMAP2 || ARCH_OMAP3
	---help---
	   Support Select Y if you want to expose some gpio pins through sysfs. 

config HRES_COUNTER
	tristate "OMAP High resolution counter"
	depends on ARCH_OMAP2 || ARCH_OMAP3
	---help---
	  Select Y if you want to enable High resolution counter for OMAP platform.

config HRES_COUNTER_TIMER32K
	bool "Use 32K sync timer for time stamps"
	depends on HRES_COUNTER
	default n
	---help---
	  Select Y if you want to use 32K clock for timestamps.

config PALM_NDUID
	tristate "Nova Device UID"
	depends on MACH_SIRLOIN || MACH_BRISKET || MACH_FLANK
	depends on PROC_FS
	depends on CRYPTO_SHA1
	---help---
		Select Y if you want to export Nova Device UID in /proc and /dev

config HARDKEY_REBOOT
   tristate "Hard keys emergency reboot"
	depends on MACH_SIRLOIN || MACH_BRISKET || MACH_FLANK
	depends on GPIO_KEYS_REBOOT_TRIGGER
	---help---
		Select Y if you want to be able to perform emergency reboot by holding 
		gpio keys.
	
config KERNEL_LOG
	bool "Kernel ram log"
	---help---
		Select Y for support for keeping kernel logs in physical memory

config BATTERY_SIMPLE
	bool "Simple battery interface"	
	help
	  Say Y to enable a simple battery interface.

config MODEM_POWER_ON_NOTIFY
	bool "Modem power-on notification"
	help
	  Say Y to enable the modem power-on notification

config HRES_COUNTER
	tristate "OMAP High resolution counter"
	depends on ARCH_OMAP2 || ARCH_OMAP3
	---help---
	  Select Y if you want to enable High resolution counter for OMAP platform.

config HRES_COUNTER_TIMER32K
	bool "Use 32K sync timer for time stamps"
	depends on HRES_COUNTER
	default n
	---help---
	  Select Y if you want to use 32K clock for timestamps.


endif # MISC_DEVICES
```

## drivers/misc/a6/Kconfig
```kconfig
menuconfig A6_SUPPORT
	tristate "Palm A6 support"
	depends on I2C
	default y
	help
	  This option enables support for Palm A6 controller.

	  To compile this driver as a module, choose M here.

if A6_SUPPORT

config A6
	tristate "Palm A6 charging controller"
	depends on I2C
	default y
	help
	 Say Y to include support for the Palm A6 charging controller.

endif # POWER_SUPPLY
```

## drivers/mmc/core/Kconfig
```kconfig
#
# MMC core configuration
#

config MMC_UNSAFE_RESUME
	bool "Allow unsafe resume (DANGEROUS)"
	help
	  If you say Y here, the MMC layer will assume that all cards
	  stayed in their respective slots during the suspend. The
	  normal behaviour is to remove them at suspend and
	  redetecting them at resume. Breaking this assumption will
	  in most cases result in data corruption.

	  This option is usually just for embedded systems which use
	  a MMC/SD card for rootfs. Most people should say N here.


config SDIO_FORCE_OPCOND_1_8V
  bool "Force SDIO card to report 1.8V operation condition."
  default n
    help
	   Select if you want to force your card to report 1.8V op condition.

config SDIO_WORKAROUND_MARVELL_CIS_B1_BUG
  bool "Enable workaround for Marvell CIS bug"
  default n
    help
	   Select to enable workaround for Marvell CIS bug.
```
